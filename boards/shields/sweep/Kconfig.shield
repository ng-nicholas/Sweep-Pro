## boards/shields/sweep/Kconfig.shield
```kconfig
# No whitespace after the comma or in your part name!
config SHIELD_SWEEP_LEFT
    def_bool $(shields_list_contains,sweep_left)

config SHIELD_SWEEP_LEFT_DISPLAY_HW
    def_bool $(shields_list_contains,sweep_left_display_hw)

# No whitespace after the comma or in your part name!
config SHIELD_SWEEP_RIGHT
    def_bool $(shields_list_contains,sweep_right)

config SHIELD_SWEEP_RIGHT_TRACKPAD
    def_bool $(shields_list_contains,sweep_right_trackpad)
```

## config/west.yml
```yaml
manifest:
  remotes:
  - name: zmkfirmware
    url-base: https://github.com/zmkfirmware
  - name: lynnlee0522
    url-base: https://github.com/lynnlee0522
  - name: nxtkb
    url-base: https://github.com/nxtkb
  - name: maatthc
    url-base: https://github.com/maatthc
  - name: ng-nicholas
    url-base: https://github.com/ng-nicholas
  projects:
  - name: zmk
    remote: zmkfirmware
    revision: cb615aee9a7c427e251f2ab62080c1a44a165da9
    import: app/west.yml
  - name: zmk-vfx-sweep-pro-display
    remote: nxtkb
    revision: 88809b0ba9f8af51e937c90d3c34edb9480e5455
  - name: zmk-behavior-report
    remote: nxtkb
    revision: 476f43da1f98b4a6150c9c0e499a257bd64a29a0
    import: west.yml
  - name: cirque-input-module
    remote: nxtkb
    revision: 8af03a4c061580c14ec8745caf0fa2dd3fc7f042
  - name: zmk-feature-appcompanion
    remote: ng-nicholas
    revision: be86962c9e8f59a8d5ac25ac763ba4fca0db2cf5
  self:
    path: config
```
